#define ZMK_BASE_LAYER(name, LT, RT, LM, RM, LB, RB, LH, RH) \
    ZMK_LAYER(                                               \
        name,                                                \
        LT RT                                                \
        LM RM                                                \
        &none LB RB &none                                    \
        &none LH RH &none                                    \
    )

#include "zmk-helpers/key-labels/totem.h"
#include "base.keymap"
